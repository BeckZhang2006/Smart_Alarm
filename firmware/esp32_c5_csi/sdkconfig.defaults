## firmware/esp32_c5_csi/sdkconfig.defaults
```kconfig
# WiFi CSI Configuration
CONFIG_ESP_WIFI_CSI_ENABLED=y
CONFIG_ESP_WIFI_CSI_CHANNEL_SCAN_INTERVAL_MS=100

# WiFi Configuration
CONFIG_ESP_WIFI_SSID="SmartAlarm_CSI"
CONFIG_ESP_WIFI_PASSWORD="12345678"

# UART Configuration for communication with WTDKP4C5-S1
CONFIG_UART_BAUDRATE=115200
CONFIG_UART_TX_PIN=5
CONFIG_UART_RX_PIN=4

# Detection Thresholds
CONFIG_PERSON_DETECT_THRESHOLD=30
CONFIG_CSI_SAMPLING_RATE=100

# Power Management
CONFIG_PM_ENABLE=y
```

## firmware/esp32_c5_transmitter/main/Kconfig.projbuild
```kconfig
menu "CSI Transmitter Configuration"

    config ESP_WIFI_SSID
        string "WiFi SSID"
        default "SmartAlarm_CSI_TX"
        help
            SSID (network name) for the CSI transmitter to create.

    config ESP_WIFI_PASSWORD
        string "WiFi Password"
        default "csicsicsi"
        help
            WiFi password (WPA or WPA2) for the CSI transmitter.

    config ESP_WIFI_CHANNEL
        int "WiFi Channel"
        range 1 13
        default 6
        help
            WiFi channel (1-13) for the CSI transmitter.

    config TX_PACKET_INTERVAL_MS
        int "Packet Interval (ms)"
        range 10 1000
        default 50
        help
            Interval between CSI packets in milliseconds.

    config TX_PACKET_SIZE
        int "Packet Size"
        range 64 1500
        default 256
        help
            Size of each CSI packet in bytes.

    config ESP_WIFI_TX_POWER
        int "WiFi TX Power (dBm)"
        range 0 20
        default 20
        help
            WiFi transmit power in dBm.

endmenu
```

## firmware/esp32_c5_transmitter/sdkconfig.defaults
```kconfig
# ESP32-C5 CSI Transmitter Configuration

# WiFi Configuration
CONFIG_ESP_WIFI_SSID="SmartAlarm_CSI_TX"
CONFIG_ESP_WIFI_PASSWORD="csicsicsi"
CONFIG_ESP_WIFI_CHANNEL=6
CONFIG_TX_PACKET_INTERVAL_MS=50
CONFIG_TX_PACKET_SIZE=256
CONFIG_ESP_WIFI_TX_POWER=20

# ESP32-C5 specific
CONFIG_IDF_TARGET="esp32c5"

# Enable WiFi
CONFIG_ESP_WIFI_ENABLED=y

# Log level
CONFIG_LOG_DEFAULT_LEVEL_INFO=y
```

## firmware/wtdkp4c5_c5_slave/main/Kconfig.projbuild
```kconfig
menu "C5 SDIO Slave Configuration"

    config TX_AP_SSID
        string "Target AP SSID"
        default "SmartAlarm_CSI_TX"
        help
            SSID of the transmitter AP to connect to.

    config TX_AP_PASSWORD
        string "Target AP Password"
        default "csicsicsi"
        help
            Password of the transmitter AP.

    config SDIO_BLOCK_SIZE
        int "SDIO Block Size"
        default 512
        help
            SDIO block size for data transfer.

    config CSI_QUEUE_SIZE
        int "CSI Queue Size"
        range 5 50
        default 20
        help
            Size of the CSI data queue.

endmenu
```

## firmware/wtdkp4c5_c5_slave/sdkconfig.defaults
```kconfig
# ESP32-C5 SDIO Slave Configuration

# Target
CONFIG_IDF_TARGET="esp32c5"

# WiFi Configuration
CONFIG_TX_AP_SSID="SmartAlarm_CSI_TX"
CONFIG_TX_AP_PASSWORD="csicsicsi"

# SDIO Configuration
CONFIG_SDIO_BLOCK_SIZE=512
CONFIG_CSI_QUEUE_SIZE=20

# Enable WiFi and CSI
CONFIG_ESP_WIFI_ENABLED=y

# Log level
CONFIG_LOG_DEFAULT_LEVEL_INFO=y
```

## firmware/wtdkp4c5_main/main/Kconfig.projbuild
```kconfig
menu "SmartAlarm Configuration"

    config ESP_WIFI_SSID
        string "WiFi AP SSID"
        default "SmartAlarm_AP"
        help
            SSID (network name) for the device AP mode.

    config ESP_WIFI_PASSWORD
        string "WiFi AP Password"
        default "12345678"
        help
            WiFi password for the device AP mode.

    config WEB_SERVER_PORT
        int "Web Server Port"
        range 1 65535
        default 80
        help
            Port number for the web server.

    config MAX_ALARMS
        int "Maximum Alarms"
        range 1 20
        default 10
        help
            Maximum number of alarms that can be set.

    config SNOOZE_INTERVAL_MS
        int "Snooze Interval (ms)"
        range 60000 900000
        default 300000
        help
        help
            Snooze interval in milliseconds (default 5 minutes).

    config ALARM_DURATION_MS
        int "Alarm Duration (ms)"
        range 10000 300000
        default 60000
        help
            How long the alarm rings before auto-snooze.

    config DEFAULT_DETECTION_THRESHOLD
        int "Default Detection Threshold"
        range 10 100
        default 30
        help
            Default threshold for person detection.

    config CSI_HISTORY_SIZE
        int "CSI History Size"
        range 10 100
        default 50
        help
            Number of CSI samples to keep in history.

    config ENABLE_DEBUG_LOG
        bool "Enable Debug Logging"
        default n
        help
            Enable verbose debug logging.

endmenu
```

## firmware/wtdkp4c5_main/sdkconfig.defaults
```kconfig
# ESP32-P4 SmartAlarm Configuration
# WTDKP4C5-S1 开发板配置 - 使用ESP32-C5作为WiFi协处理器

# Target
CONFIG_IDF_TARGET="esp32p4"

# ================================
# Wi-Fi Remote 配置 (ESP-Hosted)
# ================================
# 启用WiFi Remote
CONFIG_ESP_WIFI_REMOTE_ENABLED=y

# 启用WiFi SoftAP支持
CONFIG_ESP_WIFI_SOFTAP_SUPPORT=y

# 启用WiFi Remote Hosted库
CONFIG_ESP_WIFI_REMOTE_LIBRARY_HOSTED=y

# 选择从机目标芯片为ESP32-C5 (WiFi Remote)
CONFIG_SLAVE_IDF_TARGET_ESP32C5=y

# ESP-Hosted 协处理器目标
CONFIG_ESP_HOSTED_CP_TARGET_ESP32C5=y

# 启用ESP-Hosted组件
CONFIG_ESP_HOSTED_ENABLED=y

# SDIO配置 (WTDKP4C5-S1使用SDIO与板载C5通信)
CONFIG_ESP_HOSTED_SDIO_HOST_INTERFACE=y

# WiFi配置
CONFIG_WIFI_RMT_STATIC_RX_BUFFER_NUM=16
CONFIG_WIFI_RMT_DYNAMIC_RX_BUFFER_NUM=64
CONFIG_WIFI_RMT_DYNAMIC_TX_BUFFER_NUM=64
CONFIG_WIFI_RMT_TX_BUFFER_TYPE=1
CONFIG_WIFI_RMT_DYNAMIC_RX_MGMT_BUF=0
CONFIG_WIFI_RMT_ESPNOW_MAX_ENCRYPT_NUM=7
CONFIG_WIFI_RMT_AMPDU_TX_ENABLED=y
CONFIG_WIFI_RMT_TX_BA_WIN=32
CONFIG_WIFI_RMT_AMPDU_RX_ENABLED=y
CONFIG_WIFI_RMT_RX_BA_WIN=32

# ================================
# WiFi AP 配置
# ================================
CONFIG_ESP_WIFI_SSID="SmartAlarm_AP"
CONFIG_ESP_WIFI_PASSWORD="12345678"

# ================================
# Web服务器配置
# ================================
CONFIG_WEB_SERVER_PORT=80
CONFIG_MAX_ALARMS=10

# ================================
# 闹钟设置
# ================================
CONFIG_SNOOZE_INTERVAL_MS=300000
CONFIG_ALARM_DURATION_MS=60000
CONFIG_DEFAULT_DETECTION_THRESHOLD=30

# ================================
# CSI配置
# ================================
CONFIG_CSI_HISTORY_SIZE=50

# ================================
# 日志级别
# ================================
CONFIG_LOG_DEFAULT_LEVEL_INFO=y

# ================================
# PSRAM配置
# ================================
CONFIG_SPIRAM=y

# ================================
# WiFi Remote 性能优化参数
# ================================
CONFIG_WIFI_RMT_STATIC_RX_BUFFER_NUM=16
CONFIG_WIFI_RMT_DYNAMIC_RX_BUFFER_NUM=64
CONFIG_WIFI_RMT_DYNAMIC_TX_BUFFER_NUM=64
CONFIG_WIFI_RMT_AMPDU_TX_ENABLED=y
CONFIG_WIFI_RMT_TX_BA_WIN=32
CONFIG_WIFI_RMT_AMPDU_RX_ENABLED=y
CONFIG_WIFI_RMT_RX_BA_WIN=32

# ================================
# LWIP网络优化
# ================================
CONFIG_LWIP_TCP_SND_BUF_DEFAULT=65534
CONFIG_LWIP_TCP_WND_DEFAULT=65534
CONFIG_LWIP_TCP_RECVMBOX_SIZE=64
CONFIG_LWIP_UDP_RECVMBOX_SIZE=64
CONFIG_LWIP_TCPIP_RECVMBOX_SIZE=64
CONFIG_LWIP_TCP_SACK_OUT=y

# ================================
# 禁用蓝牙 (本项目不需要)
# ================================
# CONFIG_BT_ENABLED is not set
```
